#include <dt-bindings/zmk/input_transform.h>
#include <input/processors.dtsi>

/ {
    split_inputs {
        #address-cells = <1>;
        #size-cells = <0>;

        pointing_device_trackpad_left_split: pointing_device_trackpad_left_split@0 {
            compatible = "zmk,input-split";
            reg = <0>;
        };
    };

    pointing_device_trackpad_left_split_listener: pointing_device_trackpad_left_split_listener {
        compatible = "zmk,input-listener";
        device = <&pointing_device_trackpad_left_split>;
        status = "okay";
        input-processors = <&zip_xy_transform (INPUT_TRANSFORM_X_INVERT | INPUT_TRANSFORM_Y_INVERT)
                            &dynamic_processor_trackpad_left>;
    };
};
