/ {
    split_inputs {
        #address-cells = <1>;
        #size-cells = <0>;

        pointing_device_trackpad_right_split: pointing_device_trackpad_right_split@1 {
            compatible = "zmk,input-split";
            reg = <1>;
            device = <&pointing_device>;
        };
    };
};
