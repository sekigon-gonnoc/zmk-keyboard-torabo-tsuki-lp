/{
    split_inputs {
        #address-cells = <1>;
        #size-cells = <0>;

        pointing_device_split_right: pointing_device_split_right@1 {
            compatible = "zmk,input-split";
            reg = <1>;
            device = <&pointing_device>;
        };
    };
};
