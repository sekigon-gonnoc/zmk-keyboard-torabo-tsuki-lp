/{
    split_inputs {
        #address-cells = <1>;
        #size-cells = <0>;

        pointing_device_split_left: pointing_device_split_left@0 {
            compatible = "zmk,input-split";
            reg = <0>;
            device = <&pointing_device>;
        };
    };
};
