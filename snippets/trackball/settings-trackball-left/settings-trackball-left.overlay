#include <input_processors/zmk-input-processor-pointer-settings.dtsi>

/ {
    dynamic_processor_left: dynamic_processor_left {
        compatible = "zmk,input-processor-pointer";
        #input-processor-cells = <0>;
        status = "okay";
        encoder-sensor-indices = <0 1>;
    };

    DYNAMIC_INPUT_PROCESSOR_POINTER_SETTINGS(
        pointer_left_settings, "trackball-left", "keyboard-left", "Trackball Left",
        dynamic_processor_left, "shared")
};
