/ {
    kscan1: kscan1 {
        compatible = "zmk,kscan-4-direction-switch";

        up-gpios = <&gpio0 19 (GPIO_ACTIVE_LOW | GPIO_PULL_UP)>;
        down-gpios = <&gpio0 18 (GPIO_ACTIVE_LOW | GPIO_PULL_UP)>;
        left-gpios = <&gpio0 19 (GPIO_ACTIVE_LOW | GPIO_PULL_UP)>,
                      <&gpio0 18 (GPIO_ACTIVE_LOW | GPIO_PULL_UP)>;
        right-gpios = <&gpio0 16 (GPIO_ACTIVE_LOW | GPIO_PULL_UP)>;
        push-gpios = <&gpio0 20 (GPIO_ACTIVE_LOW | GPIO_PULL_UP)>;

        wakeup-source;
    };
};
