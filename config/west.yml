## config/west.yml
```yaml
manifest:
  remotes:
    - name: zmkfirmware
      url-base: https://github.com/zmkfirmware
    - name: sekigon-gonnoc
      url-base: https://github.com/sekigon-gonnoc
  projects:
    - name: zmk
      url: https://github.com/sekigon-gonnoc/zmk
      revision: v0.4+nemu-link
      import: app/west.yml
    - name: zmk-feature-nemu-link
      url: https://github.com/sekigon-gonnoc/zmk-feature-nemu-link
      revision: zmk-v0.4
      import: config/west.yml
    - name: zmk-feature-dynamic-settings
      remote: sekigon-gonnoc
    - name: zmk-feature-dynamic-input-processor
      remote: sekigon-gonnoc
    - name: zmk-feature-dynamic-macro
      remote: sekigon-gonnoc
    - name: zmk-feature-dynamic-combo
      remote: sekigon-gonnoc
    - name: zmk-feature-dynamic-tap-dance
      remote: sekigon-gonnoc
    - name: zmk-feature-dynamic-encoder
      remote: sekigon-gonnoc
    - name: zmk-feature-nemu-link-scan
      remote: sekigon-gonnoc
    - name: zmk-component-bmp-boost
      remote: sekigon-gonnoc
      import: west.yml
    - name: zmk-feature-status-led
      remote: sekigon-gonnoc
      revision: main
    - name: zmk-driver-paw3222
      remote: sekigon-gonnoc
      revision: torabo-tsuki-nemu-link
    - name: zmk-driver-iqs7211e
      remote: sekigon-gonnoc
    - name: zmk-feature-cdc-acm-bootloader-trigger
      remote: sekigon-gonnoc
      revision: main
    - name: zmk-feature-non-lipo-battery-management
      remote: sekigon-gonnoc
      revision: main
    - name: zmk-driver-kscan-4-direction-switch
      remote: sekigon-gonnoc
    - name: zmk-driver-hires-dial
      remote: sekigon-gonnoc
      revision: dynamic-setting
    - name: zmk-driver-nemu-link-mic
      remote: sekigon-gonnoc
  self:
    path: config
```
